# ReferencePeripheral register map
File version: 1.0
VirtMCU Golden Standard Reference Peripheral
Registers are 32-bit, read-only, no defined reset value unless marked. A register's access mark holds for its fields unless they carry their own. Offsets are from the block's base; lines under a group give offsets from that group; [hi:lo] are bit positions; {n}, {i} and the like mark numbered series; 'fields as' and 'values as' point back to an identical list; <NAME> marks a mode.

## Memory map
0x09005000 REFERENCE_PERIPHERAL — Reference Peripheral Instance

## REFERENCE_PERIPHERAL — Reference Peripheral Instance
Base 0x09005000
0x00 STATUS — Status register. Bit 0 indicates data ready.
  [0] DATA_READY — Set to 1 when data is available to read.
0x04 TX wo — Transmit register. Write to send data.
0x08 RX — Receive register. Read to consume data.
