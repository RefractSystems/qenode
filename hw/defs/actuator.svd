# Actuator register map
Vendor: VirtMCU
VirtMCU Actuator Peripheral
Registers are 32-bit, access not given, no defined reset value unless marked. A register's access mark holds for its fields unless they carry their own. Offsets are from the block's base; lines under a group give offsets from that group; [hi:lo] are bit positions; {n}, {i} and the like mark numbered series; 'fields as' and 'values as' point back to an identical list; <NAME> marks a mode.

## Memory map
0x0A000000 ACTUATOR size 0x100

## ACTUATOR
Base 0x0A000000
0x00 ID — Actuator ID
0x04 DATA_SIZE — Data size (number of elements)
0x08 GO — Trigger command execution
0x10 DATA 64-bit — Double-precision data payload
