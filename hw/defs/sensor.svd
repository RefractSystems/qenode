# Sensor register map
Vendor: VirtMCU
VirtMCU Sensor Peripheral
Registers are 32-bit, access not given, no defined reset value unless marked. A register's access mark holds for its fields unless they carry their own. Offsets are from the block's base; lines under a group give offsets from that group; [hi:lo] are bit positions; {n}, {i} and the like mark numbered series; 'fields as' and 'values as' point back to an identical list; <NAME> marks a mode.

## Memory map
0x0B000000 SENSOR size 0x100

## SENSOR
Base 0x0B000000
0x00 ID — Sensor ID
0x04 DATA_SIZE — Data size (number of elements)
0x08 GO — Trigger data latching
0x0C READY — Ready status (1 = new data available)
0x10 DATA 64-bit — Double-precision data payload
